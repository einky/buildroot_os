## Config.in
```kconfig
# InkyOS external package menus get sourced here as they're added.
source "$BR2_EXTERNAL_INKY_PATH/package/pygame-sdl2/Config.in"
source "$BR2_EXTERNAL_INKY_PATH/package/renpy/Config.in"
source "$BR2_EXTERNAL_INKY_PATH/package/inky-runtime/Config.in"
source "$BR2_EXTERNAL_INKY_PATH/package/inky-launcher/Config.in"
source "$BR2_EXTERNAL_INKY_PATH/package/inky-session/Config.in"
```

## configs/inky_defconfig
```kconfig
BR2_aarch64=y
BR2_ARM_FPU_VFPV4=y
BR2_TOOLCHAIN_EXTERNAL=y
BR2_TOOLCHAIN_EXTERNAL_BOOTLIN=y
BR2_TOOLCHAIN_EXTERNAL_BOOTLIN_AARCH64_GLIBC_STABLE=y
# Mesa/LLVM (llvmpipe) and Ren'Py's native modules need C++; the Bootlin external
# toolchain provides libstdc++. ccache keeps the large LLVM/Mesa rebuilds cheap.
BR2_INSTALL_LIBSTDCPP=y
BR2_CCACHE=y
BR2_GLOBAL_PATCH_DIR="board/raspberrypi/patches"
BR2_DOWNLOAD_FORCE_CHECK_HASHES=y
# Rootfs overlay (board/inky/overlay): /etc/default/inky-session selects the
# hardware backend (EINK_BACKEND=spi, INPUT_MODE=gpio).
BR2_ROOTFS_OVERLAY="$(BR2_EXTERNAL_INKY_PATH)/board/inky/overlay"
# Post-build chain: the stock rpi script (adds a tty1 getty, handy for bring-up),
# then the shared InkyOS finalizer (disable stock Xorg + assemble the game). The
# external one needs $(BR2_EXTERNAL_INKY_PATH); the bare rpi path resolves in
# Buildroot's own tree.
BR2_ROOTFS_POST_BUILD_SCRIPT="board/raspberrypizero2w-64/post-build.sh $(BR2_EXTERNAL_INKY_PATH)/board/common/post-build.sh"
# Post-image chain: sync-config-txt.sh first (refresh the boot config.txt from
# board/inky/config.txt so a regenerated config can never ship stale -- see the
# script header), then the stock rpi genimage post-image that packs the SD image.
BR2_ROOTFS_POST_IMAGE_SCRIPT="$(BR2_EXTERNAL_INKY_PATH)/board/inky/sync-config-txt.sh board/raspberrypizero2w-64/post-image.sh"
BR2_LINUX_KERNEL=y
BR2_LINUX_KERNEL_CUSTOM_TARBALL=y
BR2_LINUX_KERNEL_CUSTOM_TARBALL_LOCATION="$(call github,raspberrypi,linux,21b410140c47ffab5668399f6f143c7d7b935c8b)/linux-21b410140c47ffab5668399f6f143c7d7b935c8b.tar.gz"
BR2_LINUX_KERNEL_DEFCONFIG="bcm2711"
BR2_LINUX_KERNEL_DTS_SUPPORT=y
BR2_LINUX_KERNEL_INTREE_DTS_NAME="broadcom/bcm2710-rpi-zero-2-w"
BR2_LINUX_KERNEL_NEEDS_HOST_OPENSSL=y
BR2_PACKAGE_BUSYBOX_SHOW_OTHERS=y
# einky runtime (ADR 0008), hardware target: the frame pipeline + SPI panel
# driver + GPIO input bridge. Active now that the python3/graphics/Ren'Py stack
# below is enabled (inky-runtime depends on BR2_PACKAGE_PYTHON3). _SPI pulls in
# the C SPI driver (libgpiod) plus the gpiozero/xdotool GPIO input path.
BR2_PACKAGE_INKY_RUNTIME=y
BR2_PACKAGE_INKY_RUNTIME_SPI=y

# ── Boot-to-game stack (mirrors inky_qemu_defconfig; proven on the emulator) ──
# Software desktop GL: Ren'Py needs desktop GL/GLX, which the Pi's VideoCore does
# NOT expose (GL ES only) -- Mesa llvmpipe gives a real desktop-GL context in
# software. e-ink refresh is the bottleneck, so CPU rendering costs nothing, and
# it behaves identically to the emulator. Xvfb is the virtual display Ren'Py
# renders into; the runtime captures its frames and dispatches them to the panel.
BR2_PACKAGE_MESA3D_DEMOS=y
BR2_PACKAGE_MESA3D=y
BR2_PACKAGE_MESA3D_LLVM=y
BR2_PACKAGE_MESA3D_GALLIUM_DRIVER_LLVMPIPE=y
BR2_PACKAGE_MESA3D_OPENGL_GLX=y
BR2_PACKAGE_MESA3D_OPENGL_EGL=y
BR2_PACKAGE_XORG7=y
BR2_PACKAGE_XSERVER_XORG_SERVER=y
BR2_PACKAGE_XSERVER_XORG_SERVER_XVFB=y
BR2_PACKAGE_PYTHON3=y
BR2_PACKAGE_RENPY=y
# Boot-to-game supervisor (S95): Xvfb + runtime receiver/input bridge + supervised
# Ren'Py. Depends on renpy + inky-runtime + Xvfb (all enabled above).
BR2_PACKAGE_INKY_SESSION=y
# numpy + Pillow back the runtime frame pipeline (selected by inky-runtime; kept
# explicit so a savedefconfig keeps them visible).
BR2_PACKAGE_PYTHON_NUMPY=y
BR2_PACKAGE_PYTHON_PILLOW=y
BR2_PACKAGE_XZ=y
BR2_PACKAGE_RPI_FIRMWARE=y
BR2_PACKAGE_RPI_FIRMWARE_BOOTCODE_BIN=y
BR2_PACKAGE_RPI_FIRMWARE_VARIANT_PI=y
# InkyOS firmware config.txt (generated from the hardware contract by
# scripts/gen_hardware.py): base Pi boot + SPI panel bus on + button pull-ups.
# Absolute path via $(BR2_EXTERNAL_INKY_PATH): a bare "board/inky/..." would
# resolve against Buildroot's own tree, not this external tree.
BR2_PACKAGE_RPI_FIRMWARE_CONFIG_FILE="$(BR2_EXTERNAL_INKY_PATH)/board/inky/config.txt"
BR2_PACKAGE_KMOD=y
BR2_PACKAGE_KMOD_TOOLS=y
BR2_TARGET_ROOTFS_EXT2=y
BR2_TARGET_ROOTFS_EXT2_4=y
# Mesa+LLVM (libLLVM ~60-100M) + Xorg + SDL2 + Python3 + Ren'Py + numpy/Pillow
# overflow the old 120M rootfs; size like the emulator (1G) with headroom. The
# rpi genimage.cfg.in sizes the SD rootfs partition to this image, so this is the
# only size knob.
BR2_TARGET_ROOTFS_EXT2_SIZE="1200M"
# BR2_TARGET_ROOTFS_TAR is not set
BR2_PACKAGE_HOST_DOSFSTOOLS=y
BR2_PACKAGE_HOST_GENIMAGE=y
BR2_PACKAGE_HOST_KMOD_XZ=y
BR2_PACKAGE_HOST_MTOOLS=y
```

## configs/inky_qemu_defconfig
```kconfig
# InkyOS EMULATOR target -- seeded from Buildroot's qemu_aarch64_virt_defconfig.
# Graphics stack: Mesa software desktop GL (llvmpipe gallium driver, GLX+EGL), X.org
# server with Xvfb, and the SDL2 family. Ren'Py engine layer: the renpy package on
# Python 3. Ren'Py 8.5.2 vendors its own pygame (renpy.pygame) and its native
# modules pull in sdl2/sdl2_image/ffmpeg/harfbuzz/freetype/fribidi/assimp/png/jpeg/zlib
# via the renpy Config.in selects, so those need no explicit lines here. C++ toolchain
# + ccache are on because the Mesa/LLVM build needs C++ and is large.
# Build: INKY_OUT=output-qemu ./br.sh make inky_qemu_defconfig && ... make -j4
# (regenerate with `make savedefconfig` -- it drops these comments and any selected syms.)
BR2_aarch64=y
BR2_PACKAGE_HOST_LINUX_HEADERS_CUSTOM_6_18=y
BR2_TOOLCHAIN_BUILDROOT_CXX=y
BR2_CCACHE=y
BR2_GLOBAL_PATCH_DIR="board/qemu/patches"
BR2_DOWNLOAD_FORCE_CHECK_HASHES=y
BR2_SYSTEM_DHCP="eth0"
BR2_ROOTFS_OVERLAY="$(BR2_EXTERNAL_INKY_PATH)/board/qemu/overlay"
# Absolute path: a bare "board/qemu/..." would resolve against Buildroot's own
# tree (where the stock qemu post-image.sh lives), not this external tree.
BR2_ROOTFS_POST_BUILD_SCRIPT="$(BR2_EXTERNAL_INKY_PATH)/board/qemu/post-build.sh"
BR2_ROOTFS_POST_IMAGE_SCRIPT="board/qemu/post-image.sh"
BR2_ROOTFS_POST_SCRIPT_ARGS="$(BR2_DEFCONFIG)"
BR2_LINUX_KERNEL=y
BR2_LINUX_KERNEL_CUSTOM_VERSION=y
BR2_LINUX_KERNEL_CUSTOM_VERSION_VALUE="6.18.7"
BR2_LINUX_KERNEL_USE_CUSTOM_CONFIG=y
BR2_LINUX_KERNEL_CUSTOM_CONFIG_FILE="board/qemu/aarch64-virt/linux.config"
BR2_LINUX_KERNEL_NEEDS_HOST_OPENSSL=y
BR2_PACKAGE_MESA3D_DEMOS=y
BR2_PACKAGE_MESA3D=y
BR2_PACKAGE_MESA3D_LLVM=y
BR2_PACKAGE_MESA3D_GALLIUM_DRIVER_LLVMPIPE=y
BR2_PACKAGE_MESA3D_OPENGL_GLX=y
BR2_PACKAGE_MESA3D_OPENGL_EGL=y
BR2_PACKAGE_XORG7=y
BR2_PACKAGE_XSERVER_XORG_SERVER=y
BR2_PACKAGE_XSERVER_XORG_SERVER_XVFB=y
BR2_PACKAGE_PYTHON3=y
BR2_TARGET_ROOTFS_EXT2=y
BR2_TARGET_ROOTFS_EXT2_4=y
# Default ext2 size (60M) overflows: Mesa+LLVM (libLLVM.so ~63M) + X + SDL2 + Python3
# + pygame_sdl2 + the Ren'Py engine tree, ffmpeg, assimp, harfbuzz and Pillow push the
# rootfs past 512M. 1G leaves headroom for a bundled game later.
BR2_TARGET_ROOTFS_EXT2_SIZE="1G"
# BR2_TARGET_ROOTFS_TAR is not set
BR2_PACKAGE_HOST_QEMU=y
BR2_PACKAGE_HOST_QEMU_SYSTEM_MODE=y
BR2_PACKAGE_RENPY=y
# Boot-to-game session: Xvfb + supervised Ren'Py, started at boot.
BR2_PACKAGE_INKY_SESSION=y
# Runtime dep of the device frame-capture path (not a renpy build dep).
BR2_PACKAGE_PYTHON_PILLOW=y
```

## package/inky-launcher/Config.in
```kconfig
config BR2_PACKAGE_INKY_LAUNCHER
	bool "inky-launcher"
	depends on BR2_PACKAGE_PYTHON3
	depends on BR2_PACKAGE_INKY_RUNTIME
	select BR2_PACKAGE_PYTHON_PILLOW  # 1-bit frame compositing
	select BR2_PACKAGE_DEJAVU         # scalable UI font (else Pillow's default)
	help
	  The einky first-boot launcher / dashboard: the game library and
	  system settings UI that IS the appliance's front end. A pure-
	  Python app that renders 1-bit frames with Pillow and pushes them
	  through the shared `runtime` panel driver, reads the 7 GPIO
	  buttons via the runtime keymap, and spawns Ren'Py games as
	  supervised child processes.

	  It owns the panel (SPI) and buttons (GPIO) for the whole uptime;
	  games only push PNG frames and receive button names over the
	  engine-capture sockets. Consumes `inky-runtime` for the frame
	  dispatch, keymap, and SPI driver -- it does not reimplement any
	  of that (ADR 0008 / 0009).

	  The package is sourced from the launcher repo (pinned commit;
	  override with INKY_LAUNCHER_OVERRIDE_SRCDIR for a local checkout
	  -- ./br.sh wires this automatically when ../launcher exists).

	  https://github.com/einky/launcher

comment "inky-launcher needs python3 + inky-runtime"
	depends on !BR2_PACKAGE_PYTHON3 || !BR2_PACKAGE_INKY_RUNTIME
```

## package/inky-runtime/Config.in
```kconfig
config BR2_PACKAGE_INKY_RUNTIME
	bool "inky-runtime"
	depends on BR2_PACKAGE_PYTHON3
	select BR2_PACKAGE_PYTHON_NUMPY   # frame_processor dither/pack
	select BR2_PACKAGE_PYTHON_PILLOW  # eink_receiver PNG decode
	help
	  The einky `runtime`: the single owner of the e-ink frame
	  pipeline (capture -> Floyd-Steinberg dither -> 1-bit pack ->
	  dispatch), the SPI panel driver, and the GPIO/keymap input
	  bridge (ADR 0008). InkyOS does NOT reimplement any of that --
	  it builds and installs `runtime` and runs its console scripts:

	    inky-eink-receiver  in-engine path: decode PNGs pushed by
	                        Ren'Py's eink_push_callback over the
	                        engine-capture socket, then dither +
	                        dispatch them (no second dither).
	    inky-frame          Xvfb capture -> dither -> dispatch.
	    inky-input          GPIO / TCP button reader -> keypress.

	  The package is sourced from the runtime repo (pinned commit;
	  override with INKY_RUNTIME_OVERRIDE_SRCDIR for a local checkout
	  -- ./br.sh wires this automatically when ../runtime exists).

	  https://github.com/einky/runtime

if BR2_PACKAGE_INKY_RUNTIME

config BR2_PACKAGE_INKY_RUNTIME_SPI
	bool "on-device SPI panel + GPIO input (hardware target)"
	# python-gpiod needs kernel headers >= 5.10; repeat its dependency here so
	# the select below can never fire with unmet deps (kconfig silently drops
	# the selected symbol's own selects in that case -- the colorzero trap).
	depends on BR2_TOOLCHAIN_HEADERS_AT_LEAST_5_10
	select BR2_PACKAGE_PYTHON_CFFI      # _spi_driver runtime import
	select BR2_PACKAGE_LIBGPIOD2        # _spi_driver links -lgpiod (v2 API, DC/RST/BUSY)
	# Buttons are read from the gpiochip character device (input.gpio_reader).
	# gpiozero/RPi.GPIO is unusable on kernels >= 6.6: RPi.GPIO does edge
	# detection through the legacy /sys/class/gpio interface with raw BCM
	# numbers, which fail once the gpiochip sits at a dynamic global base
	# ("export_store: invalid GPIO 5" on first hardware bring-up). python-gpiod
	# conflicts with libgpiod v1, hence LIBGPIOD2 above.
	select BR2_PACKAGE_PYTHON_GPIOD     # input.gpio_reader button events
	select BR2_PACKAGE_LIBGPIOD2_TOOLS  # gpioinfo/gpioget/gpioset for bring-up
	select BR2_PACKAGE_XDOTOOL          # input.handler keysym injection
	help
	  Cross-compile the GDEM0397T81P SPI driver C extension
	  (runtime's CFFI _spi_driver) and pull in the GPIO input
	  dependencies. Enable for the Raspberry Pi hardware target
	  (EINKY_BACKEND=spi, GPIO->xdotool input).

	  Leave this OFF for the QEMU emulator: there it drives the
	  tcp/socket preview backend and feeds input through the
	  in-engine input socket (runtime's net_sender), so neither the
	  C driver nor GPIO is needed.

endif

comment "inky-runtime needs python3"
	depends on !BR2_PACKAGE_PYTHON3
```

## package/inky-session/Config.in
```kconfig
config BR2_PACKAGE_INKY_SESSION
	bool "inky-session"
	depends on BR2_PACKAGE_RENPY
	depends on BR2_PACKAGE_INKY_RUNTIME
	depends on BR2_PACKAGE_XSERVER_XORG_SERVER_XVFB
	help
	  InkyOS boot session. Installs a BusyBox-init service
	  (S95inky-session) that supervises the inky-launcher process --
	  restarting it on exit -- so the device boots straight into the
	  launcher UI and never drops to a shell.

	  The launcher (not this service) owns the e-ink panel and the
	  buttons for the whole uptime and spawns Ren'Py games itself,
	  bringing up Xvfb on demand and wiring the in-engine
	  eink_hook.rpy / input_hook.rpy to the runtime frame/dither +
	  input path over the engine-capture sockets (ADR 0008/0009).

	  Per-target behaviour (SPI panel vs emulator TCP preview, GPIO
	  buttons vs TCP input) is selected by /etc/default/inky-session,
	  shipped from the board overlay, which exports the EINKY_*
	  backend selectors the launcher reads.

	  Games are assembled at build time under /opt/games/<slug>/
	  (stock the_question from the renpy package + the InkyOS hooks
	  layered on top by the board post-build script), not vendored in
	  git.

comment "inky-session needs renpy + inky-runtime + Xvfb"
	depends on !BR2_PACKAGE_RENPY || !BR2_PACKAGE_INKY_RUNTIME \
		|| !BR2_PACKAGE_XSERVER_XORG_SERVER_XVFB
```

## package/pygame-sdl2/Config.in
```kconfig
config BR2_PACKAGE_PYGAME_SDL2
	bool "pygame_sdl2"
	depends on BR2_PACKAGE_PYTHON3
	depends on BR2_INSTALL_LIBSTDCPP # SDL2_image -> Mesa/llvm pulls libstdc++
	select BR2_PACKAGE_SDL2
	select BR2_PACKAGE_SDL2_IMAGE
	select BR2_PACKAGE_SDL2_TTF
	select BR2_PACKAGE_SDL2_MIXER
	select BR2_PACKAGE_SDL2_GFX
	select BR2_PACKAGE_JPEG
	select BR2_PACKAGE_LIBPNG
	# pygame_sdl2.image calls IMG_Init() for JPG/PNG/WEBP at import and raises
	# if none initialise; SDL2_image only builds a loader when its backing lib
	# is enabled. WEBP is also used directly by the Ren'Py engine.
	select BR2_PACKAGE_WEBP
	help
	  pygame_sdl2 is Ren'Py's reimplementation of the pygame API on
	  top of SDL2. It is the SDL2 binding layer the Ren'Py engine is
	  built on; the renpy package #includes the C headers this package
	  installs into staging.

	  Built from the renpy/pygame_sdl2 source with host Cython, pinned
	  to the tag matching the Ren'Py release used by InkyOS.

	  https://github.com/renpy/pygame_sdl2

comment "pygame_sdl2 needs a toolchain w/ C++"
	depends on BR2_PACKAGE_PYTHON3
	depends on !BR2_INSTALL_LIBSTDCPP
```
